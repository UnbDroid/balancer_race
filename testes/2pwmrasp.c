/*
    _____                                              __                           
   |     \                                            |  \                          
    \$$$$$  ______  __     __   ______   ______ ____  | $$                          
      | $$ /      \|  \   /  \ /      \ |      \    \ | $$                          
 __   | $$|  $$$$$$\\$$\ /  $$|  $$$$$$\| $$$$$$\$$$$\| $$                          
|  \  | $$| $$  | $$ \$$\  $$ | $$    $$| $$ | $$ | $$ \$$                          
| $$__| $$| $$__/ $$  \$$ $$  | $$$$$$$$| $$ | $$ | $$ __                           
 \$$    $$ \$$    $$   \$$$    \$$     \| $$ | $$ | $$|  \                          
  \$$$$$$   \$$$$$$     \$      \$$$$$$$ \$$  \$$  \$$ \$$                          
                                                                                    
                                                                                    
                                                                                    
 ________                                          __    __                         
|        \                                        |  \  |  \                        
| $$$$$$$$ __    __   ______    _______  __    __ | $$ _| $$_     ______            
| $$__    |  \  /  \ /      \  /       \|  \  |  \| $$|   $$ \   /      \           
| $$  \    \$$\/  $$|  $$$$$$\|  $$$$$$$| $$  | $$| $$ \$$$$$$  |  $$$$$$\          
| $$$$$     >$$  $$ | $$    $$| $$      | $$  | $$| $$  | $$ __ | $$    $$          
| $$_____  /  $$$$\ | $$$$$$$$| $$_____ | $$__/ $$| $$  | $$|  \| $$$$$$$$          
| $$     \|  $$ \$$\ \$$     \ \$$     \ \$$    $$| $$   \$$  $$ \$$     \          
 \$$$$$$$$ \$$   \$$  \$$$$$$$  \$$$$$$$  \$$$$$$  \$$    \$$$$   \$$$$$$$          
                                                                                    
                                                                                    
                                                                                    
                                                                                    
                                                                                    
  _______   ______   ______ ____    ______                                          
 /       \ /      \ |      \    \  /      \                                         
|  $$$$$$$|  $$$$$$\| $$$$$$\$$$$\|  $$$$$$\                                        
| $$      | $$  | $$| $$ | $$ | $$| $$  | $$                                        
| $$_____ | $$__/ $$| $$ | $$ | $$| $$__/ $$                                        
 \$$     \ \$$    $$| $$ | $$ | $$ \$$    $$                                        
  \$$$$$$$  \$$$$$$  \$$  \$$  \$$  \$$$$$$                                         
                                                                                    
                                                                                    
                                                                                    
                           __                                                       
                          |  \                                                      
  _______  __    __   ____| $$  ______                                              
 /       \|  \  |  \ /      $$ /      \                                             
|  $$$$$$$| $$  | $$|  $$$$$$$|  $$$$$$\                                            
 \$$    \ | $$  | $$| $$  | $$| $$  | $$                                            
 _\$$$$$$\| $$__/ $$| $$__| $$| $$__/ $$                                            
|       $$ \$$    $$ \$$    $$ \$$    $$                                            
 \$$$$$$$   \$$$$$$   \$$$$$$$  \$$$$$$                                             
                                                                                    
                                                                                    
                                                                                    
                                                                   __  __           
                                                                  |  \|  \          
 _______    ______    ______         __     __  ______    _______  \$$| $$  ______  
|       \  |      \  /      \       |  \   /  \|      \  /       \|  \| $$ /      \ 
| $$$$$$$\  \$$$$$$\|  $$$$$$\       \$$\ /  $$ \$$$$$$\|  $$$$$$$| $$| $$|  $$$$$$\
| $$  | $$ /      $$| $$  | $$        \$$\  $$ /      $$| $$      | $$| $$| $$    $$
| $$  | $$|  $$$$$$$| $$__/ $$         \$$ $$ |  $$$$$$$| $$_____ | $$| $$| $$$$$$$$
| $$  | $$ \$$    $$ \$$    $$          \$$$   \$$    $$ \$$     \| $$| $$ \$$     \
 \$$   \$$  \$$$$$$$  \$$$$$$            \$     \$$$$$$$  \$$$$$$$ \$$ \$$  \$$$$$$$
*/

#include<stdio.h>
//#include <iostream.h>
#include <wiringPi.h>

#define PWM0 12
#define PWM1 33

int main()
{
	int i;

	wiringPiSetupPhys();
	
	pinMode(PWM0, PWM_OUTPUT);
	pinMode(PWM1, PWM_OUTPUT);

	//setando a frequancia pwm para 10KHz com um range de 128
	//frfequancia pwm = 19.2 MHz/(range*divisor)
	//10000 = 19200000/(128*divisor) -> divisor = 15
	
	pwmSetMode(PWM_MODE_MS);//frequancia fixa
	
	pwmSetRange(128);//range 0-128
	
	pwmSetClock(15);//10KHz
	
	//pwmWrite(PWM0, 128);
	//pwmWrite(PWM1, 0);

	while(1){
		
		for(i=0; i<128; i++)
		{
			pwmWrite(PWM0, i);
			pwmWrite(PWM1, 127-i);
			usleep(10000);			
		}
		for(i--; i>=0; i--)
		{
			pwmWrite(PWM0, i);
			pwmWrite(PWM1, 127-i);
			usleep(10000);
		}
	}

	return 0;
}